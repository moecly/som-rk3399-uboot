## board/rockchip/moecly_rk3399/Kconfig
```kconfig
if TARGET_MOECLY_RK3399

config SYS_BOARD
	default "moecly_rk3399"

config SYS_VENDOR
	default "rockchip"

config SYS_CONFIG_NAME
	default "moecly_rk3399"

config BOARD_SPECIFIC_OPTIONS # dummy
	def_bool y

endif
```
